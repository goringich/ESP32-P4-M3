## components/i2c_bus/Kconfig
```kconfig
menu "i2c bus"

config I2C_BUS_SDA_GPIO
  int "SDA GPIO"
  default 1
  range 0 48

config I2C_BUS_SCL_GPIO
  int "SCL GPIO"
  default 2
  range 0 48

config I2C_BUS_FREQ_HZ
  int "frequency (Hz)"
  default 100000
  range 10000 1000000

endmenu
```
