## components/app/Kconfig
```kconfig
menu "app"

choice APP_MODE
  prompt "app mode"
  default APP_MODE_MPU9250

config APP_MODE_MPU9250
  bool "MPU9250 / I2C diagnostics"

config APP_MODE_L293D_TEST
  bool "L293D stepper test"

endchoice

config APP_TICK_LOG
  bool "log app tick"
  default y

config APP_WIFI_SMOKE
  bool "run Wi-Fi smoke test on boot"
  default y

config APP_WIFI_AP_SSID_PREFIX
  string "Wi-Fi AP SSID prefix"
  default "JC-ESP32P4M3"
  depends on APP_WIFI_SMOKE

config APP_WIFI_AP_PASSWORD
  string "Wi-Fi AP password"
  default "esp32p4m3"
  depends on APP_WIFI_SMOKE

config APP_WIFI_AP_CHANNEL
  int "Wi-Fi AP channel"
  default 1
  range 1 13
  depends on APP_WIFI_SMOKE

config APP_WIFI_SCAN_MAX_AP
  int "max AP records in scan"
  default 20
  range 1 64
  depends on APP_WIFI_SMOKE

config APP_WIFI_CONNECT
  bool "attempt Wi-Fi connect after scan"
  default n
  depends on APP_WIFI_SMOKE

config APP_WIFI_SSID
  string "Wi-Fi SSID"
  default ""
  depends on APP_WIFI_CONNECT

config APP_WIFI_PASSWORD
  string "Wi-Fi password"
  default ""
  depends on APP_WIFI_CONNECT

config APP_NET_ENABLE
  bool "enable HTTP/WebSocket control API"
  default y
  depends on APP_WIFI_SMOKE

config APP_BLE_ENABLE
  bool "enable BLE control/status bridge"
  default y

if APP_MODE_L293D_TEST

config APP_L293D_IN1_GPIO
  int "L293D IN1 GPIO"
  range 0 54
  default 3

config APP_L293D_IN2_GPIO
  int "L293D IN2 GPIO"
  range 0 54
  default 4

config APP_L293D_IN3_GPIO
  int "L293D IN3 GPIO"
  range 0 54
  default 5

config APP_L293D_IN4_GPIO
  int "L293D IN4 GPIO"
  range 0 54
  default 20

config APP_L293D_STEP_DELAY_MS
  int "L293D step delay (ms)"
  range 10 5000
  default 600

config APP_STEPPER_UART_BAUD_RATE
  int "stepper uart baud rate"
  range 9600 2000000
  default 115200

config APP_STEPPER_LED_ENABLE
  bool "enable stepper activity led"
  default n

config APP_STEPPER_LED_GPIO
  int "stepper activity led gpio"
  range 0 54
  default 2
  depends on APP_STEPPER_LED_ENABLE

config APP_CONTROL_ENABLE
  bool "enable MPU-based stabilization loop (PID + complementary filter)"
  default y
  depends on APP_MODE_L293D_TEST

config APP_CONTROL_DT_MS
  int "control loop period (ms)"
  range 5 100
  default 20
  depends on APP_CONTROL_ENABLE

config APP_CONTROL_KP_X100
  int "PID Kp x100 (e.g. 200 = 2.00)"
  range 0 50000
  default 200
  depends on APP_CONTROL_ENABLE

config APP_CONTROL_KI_X100
  int "PID Ki x100 (e.g. 10 = 0.10)"
  range 0 50000
  default 10
  depends on APP_CONTROL_ENABLE

config APP_CONTROL_KD_X100
  int "PID Kd x100 (e.g. 50 = 0.50)"
  range 0 50000
  default 50
  depends on APP_CONTROL_ENABLE

config APP_CONTROL_ALPHA_X100
  int "complementary filter alpha x100 (e.g. 98 = 0.98)"
  range 0 100
  default 98
  depends on APP_CONTROL_ENABLE

config APP_CONTROL_DEAD_ZONE_DEG_X10
  int "dead zone degrees x10 (e.g. 10 = 1.0 deg)"
  range 0 500
  default 10
  depends on APP_CONTROL_ENABLE

config APP_CONTROL_MAX_OUTPUT_SPS
  int "max output steps/s"
  range 1 200
  default 50
  depends on APP_CONTROL_ENABLE

endif

endmenu
```

## sdkconfig.defaults
```kconfig
CONFIG_LOG_DEFAULT_LEVEL_INFO=y
CONFIG_ESP_CONSOLE_UART_DEFAULT=y
CONFIG_HTTPD_WS_SUPPORT=y
CONFIG_SLAVE_IDF_TARGET_ESP32C6=y
CONFIG_ESP_WIFI_REMOTE_ENABLED=y
CONFIG_ESP_WIFI_REMOTE_LIBRARY_HOSTED=y
CONFIG_ESP_HOSTED_ENABLED=y
CONFIG_ESP_HOSTED_CP_TARGET_ESP32C6=y
CONFIG_ESP_HOSTED_P4_DEV_BOARD_FUNC_BOARD=y
CONFIG_ESP_HOSTED_SDIO_HOST_INTERFACE=y
CONFIG_ESP_HOSTED_SDIO_CLOCK_FREQ_KHZ=40000
CONFIG_ESP_HOSTED_SDIO_BUS_WIDTH=4
CONFIG_ESP_HOSTED_SDIO_TX_Q_SIZE=20
CONFIG_ESP_HOSTED_SDIO_RX_Q_SIZE=20
CONFIG_WIFI_RMT_STATIC_RX_BUFFER_NUM=16
CONFIG_WIFI_RMT_DYNAMIC_RX_BUFFER_NUM=64
CONFIG_WIFI_RMT_DYNAMIC_TX_BUFFER_NUM=64
CONFIG_WIFI_RMT_AMPDU_TX_ENABLED=y
CONFIG_WIFI_RMT_TX_BA_WIN=32
CONFIG_WIFI_RMT_AMPDU_RX_ENABLED=y
CONFIG_WIFI_RMT_RX_BA_WIN=32
CONFIG_LWIP_TCP_SND_BUF_DEFAULT=65534
CONFIG_LWIP_TCP_WND_DEFAULT=65534
CONFIG_LWIP_TCP_RECVMBOX_SIZE=64
CONFIG_LWIP_UDP_RECVMBOX_SIZE=64
CONFIG_LWIP_TCPIP_RECVMBOX_SIZE=64
CONFIG_LWIP_TCP_SACK_OUT=y
CONFIG_BT_ENABLED=y
CONFIG_BT_CONTROLLER_DISABLED=y
CONFIG_BT_BLUEDROID_ENABLED=n
CONFIG_BT_NIMBLE_ENABLED=y
CONFIG_BT_NIMBLE_TRANSPORT_UART=n
CONFIG_ESP_HOSTED_ENABLE_BT_NIMBLE=y
CONFIG_ESP_HOSTED_NIMBLE_HCI_VHCI=y
CONFIG_ESP_MAIN_TASK_STACK_SIZE=8192
CONFIG_APP_WIFI_AP_PASSWORD="esp32p4m3"
# CONFIG_APP_WIFI_CONNECT is not set
# CONFIG_APP_L293D_LEFT_INVERT is not set
CONFIG_APP_L293D_RIGHT_INVERT=y
```
